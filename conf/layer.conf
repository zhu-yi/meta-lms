## conf/layer.conf
```bitbake
# We have a conf and classes directory, add to BBPATH
BBPATH .= ":${LAYERDIR}"

# We have recipes-* directories, add to BBFILES
BBFILES += "${LAYERDIR}/recipes-*/*/*.bb \
            ${LAYERDIR}/recipes-*/*/*.bbappend"

BBFILE_COLLECTIONS += "lms-layer"
BBFILE_PATTERN_lms-layer = "^${LAYERDIR}/"

# set priority higher than meta-openembedded/meta-perl, because
# RDEPENDS_${PN} = "package (operator version)" seems not working well with
# libdbd-sqlite-perl (=1.34), increase priority of this layer to walk around.
BBFILE_PRIORITY_lms-layer = "8"

LAYERDEPENDS_lms-layer = "core perl-layer"
LAYERSERIES_COMPAT_lms-layer = "thud"
```
